## zephyr/modules/boards/geekboard_pano_v03/board.yml
```yaml
board:
  name: geekboard_pano_v03
  full_name: GeekBoard Pano Ver 0.3
  vendor: others
  socs:
    - name: stm32f103x8
```

## zephyr/modules/boards/stm32f103c6_blue/board.yml
```yaml
board:
  name: stm32f103c6_blue
  full_name: STM32 Minimum Development Board (C6Tx Blue)
  vendor: others
  socs:
    - name: stm32f103x6
```
